## firmware/tan-bridge-esp32s3/sdkconfig.defaults
```kconfig
CONFIG_ESPTOOLPY_FLASHSIZE_8MB=y
CONFIG_PARTITION_TABLE_CUSTOM=y
CONFIG_PARTITION_TABLE_CUSTOM_FILENAME="partitions.csv"
CONFIG_BOOTLOADER_LOG_LEVEL_WARN=y
CONFIG_LOG_DEFAULT_LEVEL_WARN=y
CONFIG_ESP_CONSOLE_NONE=y
CONFIG_TINYUSB_CDC_ENABLED=y
CONFIG_TINYUSB_CDC_COUNT=1
CONFIG_TINYUSB_CDC_RX_BUFSIZE=512
CONFIG_TINYUSB_DESC_MANUFACTURER_STRING="Tan Studio"
CONFIG_TINYUSB_DESC_PRODUCT_STRING="Tan Bridge Receive-Only Foundation"
CONFIG_TINYUSB_DESC_SERIAL_STRING="tan-bridge-development"
```

## firmware/tan-bridge-setup/sdkconfig.defaults
```kconfig
CONFIG_ESPTOOLPY_FLASHSIZE_8MB=y
CONFIG_BOOTLOADER_LOG_LEVEL_WARN=y
CONFIG_LOG_DEFAULT_LEVEL_WARN=y
CONFIG_ESP_CONSOLE_NONE=y
CONFIG_TINYUSB_CDC_ENABLED=y
CONFIG_TINYUSB_CDC_COUNT=1
CONFIG_TINYUSB_CDC_RX_BUFSIZE=512
CONFIG_TINYUSB_DESC_MANUFACTURER_STRING="Tan Studio"
CONFIG_TINYUSB_DESC_PRODUCT_STRING="Tan Bridge Setup Development"
CONFIG_TINYUSB_DESC_SERIAL_STRING="tan-bridge-setup"
CONFIG_LWIP_DNS_SUPPORT_MDNS_QUERIES=y
```

## firmware/usb-role-probe/sdkconfig.defaults
```kconfig
CONFIG_ESPTOOLPY_FLASHSIZE_4MB=y
CONFIG_BOOTLOADER_LOG_LEVEL_NONE=y
CONFIG_LOG_DEFAULT_LEVEL_NONE=y
CONFIG_ESP_CONSOLE_NONE=y
CONFIG_TINYUSB_CDC_ENABLED=y
CONFIG_TINYUSB_CDC_COUNT=1
CONFIG_TINYUSB_CDC_RX_BUFSIZE=512
CONFIG_TINYUSB_DESC_MANUFACTURER_STRING="Tan Studio"
CONFIG_TINYUSB_DESC_PRODUCT_STRING="Tan USB Role Probe"
CONFIG_TINYUSB_DESC_SERIAL_STRING="role-probe"
```
